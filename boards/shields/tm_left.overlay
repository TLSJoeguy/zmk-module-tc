#include "teclado_mayoraz.dtsi" // The shared dtsi file is included in the overlay

// Label of the kscan node in the dtsi
// I may add extra functions to this half in the future, and if so, will define more pins here
&kscan0 {
//   col-gpios
//        = <&pro_micro 10 GPIO_ACTIVE_HIGH>
//        , <&pro_micro 11 GPIO_ACTIVE_HIGH>
//        , <&pro_micro 13 GPIO_ACTIVE_HIGH>
//        ;
};
