## boards/shields/Kconfig.defconfig
```kconfig
if SHIELD_TM_RIGHT

# Name must be less than 16 characters long!
config ZMK_KEYBOARD_NAME
    default "Teclado Mayoraz"

config ZMK_SPLIT_ROLE_CENTRAL
    default y

endif

if SHIELD_TM_RIGHT || SHIELD_TM_LEFT

config ZMK_SPLIT
    default y

endif
```

## boards/shields/Kconfig.shield
```kconfig
config SHIELD_TECLADO_MAYORAZ_RIGHT
    def_bool $(shields_list_contains,teclado_mayoraz_right)

config SHIELD_TECLADO_MAYORAZ_LEFT
    def_bool $(shields_list_contains,teclado_mayoraz_left)
```

## boards/shields/tm/Kconfig.shield
```kconfig
# No whitespace after the comma or in your part name!
config SHIELD_TM_RIGHT
    def_bool $(shields_list_contains,tm_right)

# No whitespace after the comma or in your part name!
config SHIELD_TM_LEFT
    def_bool $(shields_list_contains,tm_left)
```
