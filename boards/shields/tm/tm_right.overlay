#include "tm.dtsi" // The shared dtsi file is included in the overlay

// Figure out what is needed for the PMW3610 and scrollwheel and add it!

&default_transform { // Offset of 8 because the left side has 8 columns
    col-offset = <8>;
};
